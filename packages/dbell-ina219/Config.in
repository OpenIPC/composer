## packages/dbell-ina219/Config.in
```kconfig
config BR2_PACKAGE_DBELL_INA219
	bool "dbell-ina219"
	default n
	help
	  Simple I2C telemetry system

	  https://dbell.ca
```

## packages/faceter-camera/Config.in
```kconfig
config BR2_PACKAGE_FACETER_CAMERA
	bool "faceter-camera"
	default n
	help
	  Faceter camera application
```

## packages/gps-openipc/Config.in
```kconfig
config BR2_PACKAGE_GPS_OPENIPC
	bool "gps-openipc"
	default n
	help
	  Minimalistic package for getting coordinates and time from GPS receiver.

	  https://openipc.org
```

## packages/i2c-gpio-custom/Config.in
```kconfig
config BR2_PACKAGE_I2C_GPIO_CUSTOM
	bool "i2c-gpio-custom"
	depends on BR2_LINUX_KERNEL
	default n
	help
	  Custom GPIO-based I2C driver

	  https://raw.githubusercontent.com/digitalloggers/i2c-gpio-custom/master/i2c-gpio-custom.c

comment "i2c-gpio-custom needs a Linux kernel to be built"
	depends on !BR2_LINUX_KERNEL
```

## projects/gk7205v200_lite_meldana/general/package/webui/Config.in
```kconfig
config BR2_PACKAGE_WEBUI
	bool "webui"
	help
	  The simplest web interface constructor based on
	  httpd and haserl.

	  https://openipc.org
```

## projects/ssc30kq_add/br-ext-chip-sigmastar/Config.in
```kconfig
source "$BR2_EXTERNAL_SIGMASTAR_PATH/package/sigmastar-osdrv-infinity6e/Config.in"
```

## t31_dbell/br-ext-chip-ingenic/Config.in
```kconfig
source "$BR2_EXTERNAL_INGENIC_PATH/linux/Config.ext.in"
source "$BR2_EXTERNAL_INGENIC_PATH/package/dbell-ina219/Config.in"
source "$BR2_EXTERNAL_INGENIC_PATH/package/dbell-param/Config.in"
source "$BR2_EXTERNAL_INGENIC_PATH/package/dbell-web/Config.in"
source "$BR2_EXTERNAL_INGENIC_PATH/package/dbell-x4/Config.in"
source "$BR2_EXTERNAL_INGENIC_PATH/package/dropbear-openipc/Config.in"
source "$BR2_EXTERNAL_INGENIC_PATH/package/fwprintenv-openipc/Config.in"
source "$BR2_EXTERNAL_INGENIC_PATH/package/ingenic-osdrv-t31/Config.in"
source "$BR2_EXTERNAL_INGENIC_PATH/package/ingenic_patcher/Config.in"
source "$BR2_EXTERNAL_INGENIC_PATH/package/ipctool/Config.in"
source "$BR2_EXTERNAL_INGENIC_PATH/package/libcurl-openipc/Config.in"
source "$BR2_EXTERNAL_INGENIC_PATH/package/linux-firmware-openipc/Config.in"
source "$BR2_EXTERNAL_INGENIC_PATH/package/mbedtls-openipc/Config.in"
source "$BR2_EXTERNAL_INGENIC_PATH/package/vtund-openipc/Config.in"
```
